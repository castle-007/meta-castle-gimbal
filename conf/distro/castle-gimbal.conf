## conf/distro/castle-gimbal.conf
```bitbake
require conf/distro/poky.conf

DISTRO = "castle-gimbal"
DISTRO_NAME = "Castle Gimbal"
DISTRO_VERSION = "1.0"

INIT_MANAGER = "systemd"

DISTRO_FEATURES:append = " systemd wifi blutooth"
DISTRO_FEATURES:remove = " sysvinit"

VIRTUAL-RUNTIME_init_manager = "systemd"
VIRTUAL-RUNTIME_initscripts = ""

EXTRA_IMAGE_FEATURES ?= "debug-tweaks"
```

## conf/layer.conf
```bitbake
# We have a conf and classes directory, add to BBPATH
BBPATH .= ":${LAYERDIR}"

# We have recipes-* directories, add to BBFILES
BBFILES += "${LAYERDIR}/recipes-*/*/*.bb \
            ${LAYERDIR}/recipes-*/*/*.bbappend"

BBFILE_COLLECTIONS += "castlegimbal"
BBFILE_PATTERN_castlegimbal = "^${LAYERDIR}/"
BBFILE_PRIORITY_castlegimbal = "6"

LAYERDEPENDS_meta-castle-gimbal = "core raspberry openembbed-layer meta-python"
LAYERSERIES_COMPAT_meta-castle-gimbal = "scarthgap"
```

## conf/machine/include/castle-rpi3.inc
```bitbake
# Castle gimbal Raspberry Pi 3 board settings
ENABLE_I2C = "1"
ENABLE_UART = "1"

RPI_EXTRA_CONFIG += "\
dtparam=i2c_arm=on\n\
dtparam=i2c1=on\n\
dtoverlay=miniuart-bt\n\
uart_2ndstage=1\n\
dtoverlay=pwm-2chan\n\
camera_auto_detect=1\n\
start_x=1\n\
gpu_mem=128\n\
"

KERNEL_MODULE_AUTOLOAD += "i2c-dev pwm-bcm2835"
RPI_KERNEL_DEVICETREE_OVERLAYS:append = " overlays/pwm-2chan.dtbo"
```
